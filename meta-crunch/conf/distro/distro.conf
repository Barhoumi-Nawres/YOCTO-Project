## meta-crunch/conf/distro/distro.conf
```bitbake
#Custom distro based on poky distro

DISTRO = "distro-qemu"
DISTRO_NAME= "reference distro based on paky"
DISTRO_VERSION = "2025.10"

require conf/distro/poky.conf

#Enable init manager
INIT_MANAGER = "systemd"

#type of package 
PACKAGE_CLASSES = "package_ipk"
```
